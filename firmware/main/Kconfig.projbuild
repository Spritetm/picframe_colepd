## firmware/main/Kconfig.projbuild
```kconfig
menu "Photoframe Configuration"

	config PHOTOFRAME_BASE_URL
		string "Base URL"
		default "http://example.com/"
		help
			Base URL. Points to a http (not https) URL where the epd-info.php etc files can be found.
			Note that this MUST end with a / character!
	
endmenu
```

## firmware/sdkconfig.defaults
```kconfig
CONFIG_BOOTLOADER_APP_ROLLBACK_ENABLE=y
CONFIG_ESPTOOLPY_FLASHSIZE_4MB=y
CONFIG_PARTITION_TABLE_CUSTOM=y
CONFIG_PHOTOFRAME_BASE_URL="http://example.com/please_configure_this_url_in_menuconfig/"
CONFIG_HTTPD_MAX_REQ_HDR_LEN=2048
CONFIG_ESP_SLEEP_POWER_DOWN_FLASH=y
# CONFIG_ESP_SLEEP_FLASH_LEAKAGE_WORKAROUND is not set
CONFIG_ESP_PHY_REDUCE_TX_POWER=y
CONFIG_ESP_DEFAULT_CPU_FREQ_MHZ_80=y
CONFIG_ESP_MAIN_TASK_STACK_SIZE=8192
CONFIG_ESP_CONSOLE_USB_SERIAL_JTAG=y
CONFIG_ESP_TASK_WDT_PANIC=y
CONFIG_ESP_TASK_WDT_TIMEOUT_S=10
CONFIG_ESP_PANIC_HANDLER_IRAM=y
# CONFIG_ESP_WIFI_STA_DISCONNECTED_PM_ENABLE is not set
# CONFIG_ESP_PROTOCOMM_SUPPORT_SECURITY_VERSION_2 is not set
CONFIG_WIFI_PROV_BLE_FORCE_ENCRYPTION=y
CONFIG_WIFI_MANAGER_MAX_RETRY_START_AP=9999999
CONFIG_DEFAULT_AP_SSID="photoframe"
CONFIG_DEFAULT_AP_PASSWORD=""
```
